## sdkconfig.defaults
```kconfig
CONFIG_BT_ENABLED=y
CONFIG_BT_NIMBLE_ENABLED=y
CONFIG_BT_NIMBLE_50_FEATURE_SUPPORT=n
CONFIG_BLINK_LED_GPIO=y
CONFIG_BLINK_GPIO=2
CONFIG_ESP_SYSTEM_PANIC_PRINT_HALT=y
```
